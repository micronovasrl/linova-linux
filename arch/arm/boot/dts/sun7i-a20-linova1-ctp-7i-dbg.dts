// SPDX-License-Identifier: (GPL-2.0+ OR MIT)
/*
 * Device Tree Source for LiNova1 CTP 7" HMI Debug mode
 *
 * Copyright (C) 2018 Micronova srl
 *   Author: Giulio Benetti <giulio.benetti@micronovasrl.com>
 */

/dts-v1/;
#include "sun7i-a20-linova1-ctp-7i.dts"

/ {
	model = "Micronova srl LiNova1 CTP 7i Debug";
	compatible = "micronova,a20-linova1-ctp-7i-dbg", "allwinner,sun7i-a20";
};

&usb_otg {
	dr_mode = "otg";
};
